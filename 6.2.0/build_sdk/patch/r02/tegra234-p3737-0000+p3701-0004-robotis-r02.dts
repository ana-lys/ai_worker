// SPDX-License-Identifier: GPL-2.0-only
/*
 * Copyright (c) 2023 NVIDIA CORPORATION. All rights reserved.
 */

/dts-v1/;

#include "tegra234-p3737-0000+p3701-0000-robotis-r02.dts"

/ {
	model = "ROBOTIS Orin B/D";
	compatible = "nvidia,p3737-0000+p3701-0004", "nvidia,p3701-0004", "nvidia,tegra234";
};
